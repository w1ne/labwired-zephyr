## boards/labwired/lwnrf52840dk/Kconfig.defconfig
```kconfig
# Copyright (c) 2026 Andrii Shylenko
# SPDX-License-Identifier: Apache-2.0

if BOARD_LWNRF52840DK

config BT_CTLR
	default BT

endif # BOARD_LWNRF52840DK
```

## boards/labwired/lwnrf52840dk/Kconfig.lwnrf52840dk
```kconfig
# Copyright (c) 2026 Andrii Shylenko
# SPDX-License-Identifier: Apache-2.0

config BOARD_LWNRF52840DK
	select SOC_NRF52840_QIAA if BOARD_LWNRF52840DK_NRF52840
```

## boards/labwired/lwnrf52840dk/board.yml
```yaml
board:
  name: lwnrf52840dk
  vendor: labwired
  socs:
  # The real nRF52840 SoC (PCA10056 wiring); only the sim run target is added.
  - name: nrf52840
```

## boards/labwired/lwnucleo_l476rg/Kconfig.defconfig
```kconfig
# Copyright (c) 2026 Andrii Shylenko
# SPDX-License-Identifier: Apache-2.0

if BOARD_LWNUCLEO_L476RG

config SPI_STM32_INTERRUPT
	default y
	depends on SPI

endif # BOARD_LWNUCLEO_L476RG
```

## boards/labwired/lwnucleo_l476rg/Kconfig.lwnucleo_l476rg
```kconfig
# Copyright (c) 2026 Andrii Shylenko
# SPDX-License-Identifier: Apache-2.0

config BOARD_LWNUCLEO_L476RG
	select SOC_STM32L476XX
```

## boards/labwired/lwnucleo_l476rg/board.yml
```yaml
board:
  name: lwnucleo_l476rg
  vendor: labwired
  socs:
  # The real STM32L476RG SoC (NUCLEO-L476RG wiring); only the sim run target is
  # added on top of the upstream board, no silicon changes.
  - name: stm32l476xx
```

## export/template/zephyr-bme280/application/tests/bme280_read/testcase.yaml
```yaml
common:
  harness: ztest
  tags:
    - sensor
    - bme280
tests:
  app.bme280_read:
    platform_allow:
      - lwnrf52840dk/nrf52840
```

## export/template/zephyr-bme280/west.yml
```yaml
# west.yml — the exported repo is the manifest repo (self)
manifest:
  remotes:
    - name: zephyrproject-rtos
      url-base: https://github.com/zephyrproject-rtos
    - name: w1ne
      url-base: https://github.com/w1ne
  projects:
    - name: zephyr
      remote: zephyrproject-rtos
      revision: v3.7.0
      import: true
    - name: labwired-zephyr-dts
      remote: w1ne
      revision: main
      path: modules/labwired-zephyr-dts
      west-commands: west-commands.yml
  self:
    path: application
```
